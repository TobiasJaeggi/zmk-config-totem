## config/west.yml
```yaml
manifest:
  remotes:
    - name: zmkfirmware
      url-base: https://github.com/zmkfirmware
    - name: joelspadin
      url-base: https://github.com/joelspadin
    - name: dhruvinsh
      url-base: https://github.com/dhruvinsh
    - name: mctechnology17
      url-base: https://github.com/mctechnology17
    - name: urob
      url-base: https://github.com/urob
  projects:
    - name: zmk
      remote: zmkfirmware
      revision: main
      import: app/west.yml
    - name: zmk-locales
      remote: joelspadin
      revision: main
    - name: zmk-tri-state
      remote: dhruvinsh
      revision: main
    - name: zmk-dongle-display-view
      remote: mctechnology17
      revision: main
    - name: zmk-helpers
      remote: urob
      revision: main
  self:
    path: config
```
